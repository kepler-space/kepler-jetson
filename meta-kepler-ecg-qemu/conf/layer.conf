## meta-kepler-ecg-qemu/conf/layer.conf
```bitbake
BBPATH .= ":${LAYERDIR}"
BBFILES += "${LAYERDIR}/recipes-*/*/*.bb ${LAYERDIR}/recipes-*/*/*.bbappend"

BBFILE_COLLECTIONS += "kepler-ecg-qemu"
BBFILE_PATTERN_kepler-ecg-qemu = "^${LAYERDIR}/"
BBFILE_PRIORITY_kepler-ecg-qemu = "50"

LAYERVERSION_kepler-ecg-qemu = "1"
LAYERDEPENDS_kepler-ecg-qemu = "core kepler-jetson"
LAYERSERIES_COMPAT_kepler-ecg-qemu = "scarthgap"
```
