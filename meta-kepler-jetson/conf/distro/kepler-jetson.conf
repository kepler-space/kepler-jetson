## meta-kepler-jetson/conf/distro/kepler-jetson.conf
```bitbake
DISTRO = "kepler-jetson"
DISTRO_NAME = "Kepler Jetson Distro"
DISTRO_VERSION_BASE = "0.1.0"
DISTRO_VERSION = "${DISTRO_VERSION_BASE}+snapshot-${METADATA_REVISION}"
DISTRO_CODENAME = "nobricks"
SDK_VENDOR = "-keplersdk"
SDK_VERSION := "${@'${DISTRO_VERSION}'.replace('snapshot-${METADATA_REVISION}','snapshot')}"
SDK_VERSION[vardepvalue] = "${SDK_VERSION}"

MAINTAINER = "Kepler Team <software@kepler.space>"

TARGET_VENDOR = "-kepler"

LOCALCONF_VERSION = "1"

DISTRO_FEATURES ?= "${DISTRO_FEATURES_DEFAULT} multiarch systemd pam virtualization usrmerge"

# Jetson platforms do not use linux-yocto, but for QEMU testing
# align with the poky distro.
PREFERRED_VERSION_linux-yocto ?= "5.19%"
PREFERRED_VERSION_linux-yocto-rt ?= "5.19%"

SDK_NAME = "${DISTRO}-${TCLIBC}-${SDKMACHINE}-${IMAGE_BASENAME}-${TUNE_PKGARCH}-${MACHINE}"
SDKPATHINSTALL = "/opt/${DISTRO}/${SDK_VERSION}"

TCLIBCAPPEND = ""

PACKAGE_CLASSES ?= "package_rpm"

SANITY_TESTED_DISTROS ?= " \
            ubuntu-22.04 \n \
            "

# Most NVIDIA-supplied services expect systemd
INIT_MANAGER = "systemd"

require conf/distro/include/no-static-libs.inc
require conf/distro/include/yocto-uninative.inc
require conf/distro/include/security_flags.inc
INHERIT += "uninative"

LICENSE_FLAGS_ACCEPTED += "commercial_faad2 commercial_x264"

USE_REDUNDANT_FLASH_LAYOUT_DEFAULT ?= "1"
```

## meta-kepler-jetson/conf/layer.conf
```bitbake
BBPATH .= ":${LAYERDIR}"
BBFILES += "${LAYERDIR}/recipes-*/*/*.bb ${LAYERDIR}/recipes-*/*/*.bbappend"

BBFILE_COLLECTIONS += "kepler-jetson"
BBFILE_PATTERN_kepler-jetson = "^${LAYERDIR}/"
BBFILE_PRIORITY_kepler-jetson = "50"

LAYERVERSION_kepler-jetson = "1"
LAYERDEPENDS_kepler-jetson = "core"
LAYERSERIES_COMPAT_kepler-jetson = "scarthgap"
```

## meta-kepler-jetson/conf/machine/kepler-ecg-v1-64gb.conf
```bitbake
#@TYPE: Machine
#@NAME: ECG V1 with a 64GB Jetson module
#@DESCRIPTION: Kepler ECG 64GB (P3701-0005 module in Kepler ECGv1 carrier)

TEGRA_FLASHVAR_RAMCODE ?= "5"
TEGRA_FLASHVAR_CHIP_SKU ?= "00:00:00:D0"
TEGRA_BOARDSKU ?= "0005"
TEGRA_BUPGEN_SPECS ?= "fab=300;boardsku=0005;boardrev=;chipsku=00:00:00:D0;bup_type=bl \
                       fab=300;boardsku=0005;boardrev=;bup_type=kernel"
EMMC_BCT ?= "tegra234-p3701-0005-sdram-l4t.dts"
TEGRA_FLASHVAR_WB0SDRAM_BCT ?= "tegra234-p3701-0005-wb0sdram-l4t.dts"
TEGRA_FLASHVAR_BPFDTB_FILE ?= "tegra234-bpmp-3701-0005-3737-0000.dtb"

require conf/machine/kepler-ecg-v1.inc
require conf/machine/include/agx-orin.inc
```

## meta-kepler-jetson/conf/machine/kepler-ecg-v1.conf
```bitbake
#@TYPE: Machine
#@NAME: ECG V1
#@DESCRIPTION: Kepler ECG (P3701-0004 module in Kepler ECGv1 carrier)

TEGRA_FLASHVAR_RAMCODE ?= "4"
TEGRA_FLASHVAR_CHIP_SKU ?= "00:00:00:D2"
TEGRA_BOARDSKU ?= "0004"
TEGRA_BUPGEN_SPECS ?= "fab=300;boardsku=0004;boardrev=;chipsku=00:00:00:D2;bup_type=bl \
                       fab=300;boardsku=0004;boardrev=;bup_type=kernel"
EMMC_BCT ?= "tegra234-p3701-0000-sdram-l4t.dts"
TEGRA_FLASHVAR_WB0SDRAM_BCT ?= "tegra234-p3701-0000-wb0sdram-l4t.dts"
TEGRA_FLASHVAR_BPFDTB_FILE ?= "tegra234-bpmp-3701-0004-3737-0000.dtb"
NVPMODEL ?= "nvpmodel_p3701_0004"

require conf/machine/kepler-ecg-v1.inc
require conf/machine/include/agx-orin.inc
```

## meta-kepler-jetson/conf/machine/kepler-ecg-v1.inc
```bitbake
# Common configuration between ECGv1 images

# To match the partition sizes used by the L4T BSP based image
EMMC_SIZE ?= "63652757504"
ROOTFSPART_SIZE_DEFAULT ?= "57982058496"

# Disabled MB1 logging for faster boot
TEGRA_FLASHVAR_MISC_CONFIG ?= "tegra234-mb1-bct-misc-kepler-ecg-v1.dts"

# Disabled carrier board EEPROM
TEGRA_FLASHVAR_MB2BCT_CFG ?= "tegra234-mb2-bct-misc-kepler-ecg-v1.dts"

# Removed audio codec from dynamic overlay
TEGRA_PLUGIN_MANAGER_OVERLAYS ?= "tegra234-kepler-ecg-v1-dynamic.dtbo tegra234-carveouts.dtbo tegra-optee.dtbo"

# Pinmux configuration for ECGv1
TEGRA_FLASHVAR_PINMUX_CONFIG ?= "tegra234-mb1-bct-pinmux-kepler-ecg-v1.dtsi"
TEGRA_FLASHVAR_PMC_CONFIG ?= "tegra234-mb1-bct-padvoltage-default-kepler-ecg-v1.dtsi"

# Kernel device tree for ECGv1
KERNEL_DEVICETREE ?= "tegra234-kepler-ecg-v1.dtb"

# Platform name to match in UEFI bootloader during OTA updates
TNSPEC_MACHINE = "jetson-agx-orin-devkit"
```
